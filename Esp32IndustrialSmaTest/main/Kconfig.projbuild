## Esp32IndustrialSmaTest/main/Kconfig.projbuild
```kconfig
menu "Antenna A/B Test Configuration"

    config AB_WIFI_SSID
        string "Reference AP SSID"
        default "myssid"
        help
            SSID of the access point used as the reference signal source.
            Both antenna runs must target the same AP, on the same channel,
            from the same physical position, or the comparison is meaningless.

    config AB_WIFI_PASSWORD
        string "Reference AP password"
        default "mypassword"
        help
            WPA2 passphrase for the reference AP. Leave empty for an open AP.

    config AB_WIFI_CONNECT_TIMEOUT_MS
        int "Association timeout (ms)"
        range 2000 60000
        default 15000
        help
            How long to wait for association + DHCP before declaring the
            connect attempt failed. A failed connect is itself a result worth
            recording -- the run is stored with connect_ok = false.

    config AB_RSSI_SAMPLES
        int "RSSI samples per run"
        range 10 2000
        default 300
        help
            Number of RSSI readings taken per measurement run. At the default
            200 ms interval, 300 samples is a 60 second run. More samples
            narrow the confidence interval on the mean; fewer get you through
            a demo faster.

    config AB_RSSI_INTERVAL_MS
        int "RSSI sample interval (ms)"
        range 50 5000
        default 200
        help
            Delay between RSSI readings. The ESP32-S3 refreshes the cached
            RSSI on each received beacon, so sampling faster than the AP's
            beacon interval (typically 100 ms) just duplicates readings.

    config AB_PING_COUNT
        int "ICMP echo requests per run"
        range 0 500
        default 50
        help
            RSSI is a receive-side metric only. The ping loss/RTT figures give
            you a round-trip view, which is where a bad transmit path shows up.
            Set to 0 to skip the ping stage.

    config AB_PING_INTERVAL_MS
        int "ICMP echo interval (ms)"
        range 50 5000
        default 200

    config AB_PING_TARGET
        string "ICMP echo target (blank = default gateway)"
        default ""
        help
            Hostname or dotted-quad to ping. Leave blank to ping the DHCP
            default gateway, which keeps the test on the local RF link instead
            of measuring your internet uplink.

    config AB_SCAN_MAX_AP
        int "Maximum APs recorded per scan"
        range 8 128
        default 48
        help
            Upper bound on the AP census. The number of distinct BSSIDs a scan
            can hear is a useful antenna-sensitivity proxy that does not depend
            on any single access point.

endmenu
```

## crack_the_safe_waveshare_rotary_encoder_game/components/knob_board/Kconfig
```kconfig
menu "Knob board"

    config KNOB_BOARD_INVERT
        bool "Invert knob direction"
        default n
        help
            Swap clockwise and anticlockwise. The knob's A contact is wired as
            clockwise on the Waveshare 1.8" module; set this only if a unit
            turns the wrong way.

    choice KNOB_BOARD_HAPTIC_MOTOR
        prompt "Haptic motor type"
        default KNOB_BOARD_HAPTIC_MOTOR_LRA
        help
            What the DRV2605L's OUT+/OUT- drive. The schematic labels them
            LRA_P / LRA_N, and on the board the motor only moves when driven
            as an LRA: in ERM mode (what Waveshare's demo selects) it gets a
            near-DC drive and barely stirs.

        config KNOB_BOARD_HAPTIC_MOTOR_LRA
            bool "LRA (linear resonant actuator) -- this board"
        config KNOB_BOARD_HAPTIC_MOTOR_ERM
            bool "ERM (eccentric rotating mass)"
    endchoice

    config KNOB_BOARD_HAPTIC_ROM_LIBRARY
        int "DRV2605 waveform library"
        range 1 7
        default 6 if KNOB_BOARD_HAPTIC_MOTOR_LRA
        default 5
        help
            6 is the LRA library; 1-5 are ERM libraries, 7 the 4.5 V ERM one.

    config KNOB_BOARD_HAPTIC_LRA_PERIOD
        int "LRA open-loop drive period (OL_LRA_PERIOD)"
        range 1 127
        default 51
        depends on KNOB_BOARD_HAPTIC_MOTOR_LRA
        help
            Open loop drives the LRA at 1 / (period x 98.46 us). 51 is the
            DRV2605L's reset value, about 199 Hz, inside the 170-235 Hz band
            small coin LRAs resonate in. Nudge it if the buzz feels weak:
            lower is a higher frequency.

endmenu
```

## elecrow-10_1-meshtastic/components/meshtastic_node/Kconfig
```kconfig
menu "Meshtastic node"

    choice MESH_SOCKET_PINMAP
        prompt "Wireless-module socket pin map"
        default MESH_SOCKET_AUTO
        help
            CrowPanel Advance P4 V1.2 moved the socket's IRQ/RESET lines
            (V1.0/V1.1: IRQ=GPIO53 RESET=GPIO54, V1.2: IRQ=GPIO27 RESET=GPIO28).
            Auto-detect reads both candidate IRQ pins as inputs only.

        config MESH_SOCKET_AUTO
            bool "Auto-detect"
        config MESH_SOCKET_V1_1
            bool "V1.0 / V1.1 (IRQ 53, RESET 54)"
        config MESH_SOCKET_V1_2
            bool "V1.2 (IRQ 27, RESET 28)"
    endchoice

    choice MESH_REGION
        prompt "Default LoRa region"
        default MESH_REGION_US
        help
            Used until a region is set from the Meshtastic app. The Elecrow
            SX1262 module is a 915 MHz part, so only 915 MHz bands are offered.

        config MESH_REGION_US
            bool "US (902-928 MHz)"
        config MESH_REGION_ANZ
            bool "ANZ (915-928 MHz)"
    endchoice

    config MESH_TX_POWER_DBM
        int "Default TX power (dBm, 0 = region maximum)"
        range 0 22
        default 22

endmenu
```

## elecrow-1_28-rotary-encoder-esp32s3/components/crowpanel_board/Kconfig
```kconfig
menu "CrowPanel 1.28in board"

comment "Display"

config CROWPANEL_LCD_BGR
    bool "Panel expects BGR element order"
    default y
    help
      Swaps red and blue. y is VERIFIED on hardware (TrailCurrent Capstan),
      against a deliberate red/green/blue test pattern rather than a screen
      of UI chrome, which will not show a red/blue swap.

      Do not derive this from the vendor's LovyanGFX `cfg.rgb_order`
      (false on this board). It does not map onto esp_lcd's element order
      the way the name suggests -- deriving it from there gave the wrong
      colours.

config CROWPANEL_LCD_MIRROR_X
    bool "Mirror the display horizontally"
    default y
    help
      y is VERIFIED on hardware: text reads backwards without it.

      This flips the DISPLAY only. The touch layer has its own options
      below, and on this board they are NOT the same value.

config CROWPANEL_LCD_MIRROR_Y
    bool "Mirror the display vertically"
    default n
    help
      With MIRROR_X this gives a 180-degree rotation, for a panel mounted
      upside down. Mirror the touch to match.

comment "Touch"

config CROWPANEL_TOUCH_MIRROR_X
    bool "Mirror touch horizontally"
    default n
    help
      Independent of the display transform, and on this board deliberately
      different from it: the display needs MIRROR_X, the touch layer
      already reports in the corrected orientation. Tying the two together
      gives a perfect display with back-to-front touch.

config CROWPANEL_TOUCH_MIRROR_Y
    bool "Mirror touch vertically"
    default n

config CROWPANEL_TOUCH_SWAP_XY
    bool "Swap touch X and Y axes"
    default n

comment "Rotary ring"

config CROWPANEL_ENCODER_STEPS_PER_DETENT
    int "Quadrature counts per detent"
    range 1 8
    default 4
    help
      Counts the 4x quadrature decoder produces per mechanical detent.
      VERIFIED on hardware: 4. The EC3501 datasheet's "1 pulse per 2
      detents" would give 2, and at 2 every felt click moves by two -- its
      own section 4-2 (30 pulses per revolution per phase) is the one the
      board agrees with. Enable CROWPANEL_ENCODER_DEBUG and turn one detent
      to measure a different unit.

config CROWPANEL_ENCODER_INVERT
    bool "Invert rotation direction"
    default n
    help
      Clockwise must increase. VERIFIED on hardware: this board counts the
      right way round without inverting (unlike the MaTouch 2.1in).

config CROWPANEL_ENCODER_DEBUG
    bool "Log raw encoder counts"
    default n

config CROWPANEL_LONG_PRESS_MS
    int "Ring long-press duration (ms)"
    range 300 3000
    default 700

comment "LED ring"

config CROWPANEL_LEDS_MAX_BRIGHTNESS
    int "Maximum LED ring brightness (percent)"
    range 1 100
    default 100
    help
      Ceiling applied to every LED write. 100 is full scale, the brightest
      the WS2812s go. Lower it if the ring is too bright in a dark room
      (TrailCurrent Capstan runs this board at 40 on a wall).

endmenu
```

## elecrow-1_46-rotary-encoder-esp32s3/components/crowpanel_board/Kconfig
```kconfig
menu "CrowPanel 1.46in board"

comment "Display"

config CROWPANEL_LCD_BGR
    bool "Panel expects BGR element order"
    default n
    help
      Swaps red and blue. n (RGB) is VERIFIED on hardware (TrailCurrent
      Capstan), against a deliberate red/green/blue test pattern rather than
      a screen of UI chrome, which will not show a red/blue swap.

      This is the OPPOSITE of the 1.28in board, which needs y. They are
      different controllers driving differently-bonded glass; do not copy
      one board's value to the other.

      Do not derive this from the vendor's LovyanGFX `cfg.rgb_order`
      either (true on this board). It does not map onto esp_lcd's element
      order the way the name suggests -- on both CrowPanels it is the exact
      inverse of what the panel needs.

config CROWPANEL_LCD_MIRROR_X
    bool "Mirror the display horizontally"
    default n
    help
      n is what the TrailCurrent Capstan firmware runs on this board. The
      1.28in needs y; this panel does not. If text reads backwards --
      mirrored rather than upside down -- flip this.

      This flips the DISPLAY only. The touch layer has its own options
      below, and the two are independent.

config CROWPANEL_LCD_MIRROR_Y
    bool "Mirror the display vertically"
    default n
    help
      With MIRROR_X this gives a 180-degree rotation, for a panel mounted
      upside down. Mirror the touch to match.

comment "Touch"

config CROWPANEL_TOUCH_MIRROR_X
    bool "Mirror touch horizontally"
    default n
    help
      Independent of the display transform. The touch controller is a
      separate device whose axes are fixed by how ITS layer is bonded, so
      work this out on the glass rather than copying the display setting.

      NOT YET VERIFIED on this board: Capstan, where the rest of this board
      layer comes from, keeps touch off. If a tap on the left lands on the
      right, set this.

config CROWPANEL_TOUCH_MIRROR_Y
    bool "Mirror touch vertically"
    default n
    help
      NOT YET VERIFIED on this board -- see CROWPANEL_TOUCH_MIRROR_X.

config CROWPANEL_TOUCH_SWAP_XY
    bool "Swap touch X and Y axes"
    default n

comment "Rotary ring"

config CROWPANEL_ENCODER_STEPS_PER_DETENT
    int "Quadrature counts per detent"
    range 1 8
    default 2
    help
      Counts the 4x quadrature decoder produces per mechanical detent.
      VERIFIED on hardware: 2. At 4 it takes two detents to move once.

      The 1.28in is 4 -- the two boards are pin-identical but do NOT share
      an encoder, and neither value may be derived from the other. Enable
      CROWPANEL_ENCODER_DEBUG and turn one detent to measure a different
      unit.

config CROWPANEL_ENCODER_INVERT
    bool "Invert rotation direction"
    default n
    help
      Clockwise must increase. NOT YET VERIFIED on this board: n matches
      the 1.28in, and Capstan records the 1.46in as unconfirmed. If
      clockwise moves the selection backwards on your unit, set this.

config CROWPANEL_ENCODER_DEBUG
    bool "Log raw encoder counts"
    default n

config CROWPANEL_LONG_PRESS_MS
    int "Ring long-press duration (ms)"
    range 300 3000
    default 700

comment "LED ring"

config CROWPANEL_LEDS_MAX_BRIGHTNESS
    int "Maximum LED ring brightness (percent)"
    range 1 100
    default 100
    help
      Ceiling applied to every LED write. 100 is full scale, the brightest
      the WS2812s go. Lower it if the ring is too bright in a dark room
      (TrailCurrent Capstan runs this board at 40 on a wall).

endmenu
```

## makerfab-2_1-rotary-encoder-esp32s3/components/matouch_board/Kconfig
```kconfig
menu "MaTouch 2.1in board"

config MATOUCH_LCD_SWAP_RB
    bool "Swap the red and blue channels"
    default y
    help
      The vendor firmware and the vendor wiki label the panel's red and blue
      data pins opposite ways round. The pin map follows the wiki; this swaps
      the groups when they are handed to esp_lcd. y is VERIFIED on hardware
      (TrailCurrent Capstan). If red and blue look swapped, flip this rather
      than editing the pin map.

comment "Touch"

config MATOUCH_TOUCH_MIRROR_X
    bool "Mirror touch horizontally"
    default n
    help
      Independent of the display transform. The touch layer is a separate
      device whose axes are fixed by how it is bonded, so work this out on
      the glass rather than copying the display's setting.

config MATOUCH_TOUCH_MIRROR_Y
    bool "Mirror touch vertically"
    default n

config MATOUCH_TOUCH_SWAP_XY
    bool "Swap touch X and Y axes"
    default n

comment "Rotary ring"

config MATOUCH_ENCODER_STEPS_PER_DETENT
    int "Quadrature counts per detent"
    range 1 8
    default 4
    help
      Counts the 4x quadrature decoder produces per mechanical detent. Too
      low and one felt click moves by two; too high and clicks are
      swallowed. Enable MATOUCH_ENCODER_DEBUG and turn one detent to measure.

config MATOUCH_ENCODER_INVERT
    bool "Invert rotation direction"
    default y
    help
      Clockwise must increase. VERIFIED on hardware: this board counts
      backwards without it.

config MATOUCH_ENCODER_DEBUG
    bool "Log raw encoder counts"
    default n

config MATOUCH_LONG_PRESS_MS
    int "Ring long-press duration (ms)"
    range 300 3000
    default 700

endmenu
```
